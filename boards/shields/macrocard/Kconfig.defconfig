## boards/shields/macrocard/Kconfig.defconfig
```kconfig
if SHIELD_MACROCARD_WIN || SHIELD_MACROCARD_WIN_MEDIA || SHIELD_MACROCARD_MAC

config ZMK_KEYBOARD_NAME
    default "Macrocard"

config PWM
    default y

config LED_PWM
    default y

endif
```

## boards/shields/macrocard/Kconfig.shield
```kconfig
config SHIELD_MACROCARD_WIN
    def_bool $(shields_list_contains,macrocard_win)

config SHIELD_MACROCARD_MAC
    def_bool $(shields_list_contains,macrocard_mac)
```

## config/west.yml
```yaml
manifest:
  remotes:
    - name: zmkfirmware
      url-base: https://github.com/zmkfirmware
    - name: caksoylar
      url-base: https://github.com/caksoylar
    - name: olsen-cole
      url-base: https://github.com/olsen-cole
  projects:
    - name: zmk
      remote: zmkfirmware
      # Pinning to V0.2, instead of main for compatibility
      revision: v0.2
      # revision: main
      import: app/west.yml
    - name: zmk-smart-toggle
      remote: caksoylar
      revision: main
    - name: zmk-rgbled-widget
      remote: olsen-cole
      revision: main
  self:
    path: config
```
